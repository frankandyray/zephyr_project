## app_test_1a/build/b_l4s5i_iot01a/Kconfig/arch/Kconfig.tmp
```kconfig
# Load Zephyr Arch Kconfig descriptions.
osource "C:/Users/user/zephyrproject/zephyr/arch/rx/Kconfig"
osource "C:/Users/user/zephyrproject/zephyr/arch/x86/Kconfig"
osource "C:/Users/user/zephyrproject/zephyr/arch/xtensa/Kconfig"
osource "C:/Users/user/zephyrproject/zephyr/arch/sparc/Kconfig"
osource "C:/Users/user/zephyrproject/zephyr/arch/riscv/Kconfig"
osource "C:/Users/user/zephyrproject/zephyr/arch/posix/Kconfig"
osource "C:/Users/user/zephyrproject/zephyr/arch/mips/Kconfig"
osource "C:/Users/user/zephyrproject/zephyr/arch/arm64/Kconfig"
osource "C:/Users/user/zephyrproject/zephyr/arch/arm/Kconfig"
osource "C:/Users/user/zephyrproject/zephyr/arch/arc/Kconfig"
```

## app_test_1a/build/b_l4s5i_iot01a/Kconfig/boards/Kconfig.b_l4s5i_iot01a
```kconfig
# Load board Kconfig descriptions.
osource "C:/Users/user/zephyrproject/zephyr/boards/st/b_l4s5i_iot01a/Kconfig.b_l4s5i_iot01a"
```

## app_test_1a/build/b_l4s5i_iot01a/Kconfig/boards/Kconfig.defconfig
```kconfig
# Load Zephyr board defconfig descriptions.
osource "C:/Users/user/zephyrproject/zephyr/boards/st/b_l4s5i_iot01a/Kconfig.defconfig"
```

## app_test_1a/build/b_l4s5i_iot01a/Kconfig/boards/Kconfig.tmp
```kconfig
# Load Zephyr board Kconfig descriptions.
osource "C:/Users/user/zephyrproject/zephyr/boards/st/b_l4s5i_iot01a/Kconfig"
```

## app_test_2/build/b_l4s5i_iot01a/Kconfig/boards/Kconfig.tmp
```kconfig
# Load Zephyr board Kconfig descriptions.
osource "C:/Users/ray45/zephyrproject/zephyr/boards/st/b_l4s5i_iot01a/Kconfig"
```
